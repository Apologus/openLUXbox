// NodeMCU 1.0 (ESP-12E Module)
// openLUXbox - Startup Animation Library
// Vorschlag 1: "Scanline Drop"
// Jedes Wort wird zeilenweise von oben nach unten ein- und ausgeblendet.

#ifndef OLB_INIT_H
#define OLB_INIT_H

#include <FastLED.h>

// ---------------------------------------------------------------------------
// Konstanten
// ---------------------------------------------------------------------------

#define OLB_INIT_LED_PIN        2       // GPIO D4
#define OLB_INIT_NUM_LEDS       256
#define OLB_INIT_MATRIX_W       16
#define OLB_INIT_MATRIX_H       16
#define OLB_INIT_BRIGHTNESS     75      // 20% von 255

#define OLB_INIT_DIM_BRIGHTNESS 30      // ~30% der Ziel-Helligkeit für Flacker-Phase
#define OLB_INIT_SCANLINE_MS    60      // ms pro Zeile beim Einblenden
#define OLB_INIT_PAUSE_MS       400     // Pause nachdem Wort vollständig
#define OLB_INIT_FLICKER_MS     80      // ms pro Flacker-Frame
#define OLB_INIT_FLICKER_COUNT  3       // Anzahl Flackerdurchläufe am Ende von "box"
#define OLB_INIT_FADEOUT_MS     60      // ms pro Zeile beim Ausblenden

// ---------------------------------------------------------------------------
// Bilddaten: open (magenta), LUX (gelb), box (magenta)
// Jedes Bild: 16x16, zeilenweise, Index 0 = oben links
// ---------------------------------------------------------------------------

static const uint32_t OLB_FRAME_OPEN[256] PROGMEM = {
  0x000000,0x000000,0x000000,0x000000,0x000000,0x000000,0x000000,0x000000,0x000000,0x000000,0x000000,0x000000,0x000000,0x000000,0x000000,0x000000,
  0x000000,0x000000,0x000000,0x000000,0x000000,0x000000,0x000000,0x000000,0x000000,0x000000,0x000000,0x000000,0x000000,0x000000,0x000000,0x000000,
  0x000000,0x000000,0x000000,0x000000,0x000000,0x000000,0x000000,0x000000,0x000000,0x000000,0x000000,0x000000,0x000000,0x000000,0x000000,0x000000,
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  0x000000,0x000000,0x000000,0x000000,0x000000,0x000000,0x000000,0x000000,0x000000,0x000000,0x000000,0x000000,0x000000,0x000000,0x000000,0x000000
};

static const uint32_t OLB_FRAME_LUX[256] PROGMEM = {
  0x000000,0x000000,0x000000,0x000000,0x000000,0x000000,0x000000,0x000000,0x000000,0x000000,0x000000,0x000000,0x000000,0x000000,0x000000,0x000000,
  0x000000,0x000000,0x000000,0x000000,0x000000,0x000000,0x000000,0x000000,0x000000,0x000000,0x000000,0x000000,0x000000,0x000000,0x000000,0x000000,
  0x000000,0x000000,0x000000,0x000000,0x000000,0x000000,0x000000,0x000000,0x000000,0x000000,0x000000,0x000000,0x000000,0x000000,0x000000,0x000000,
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  0x000000,0x000000,0x000000,0x000000,0x000000,0x000000,0x000000,0x000000,0x000000,0x000000,0x000000,0x000000,0x000000,0x000000,0x000000,0x000000
};

static const uint32_t OLB_FRAME_BOX[256] PROGMEM = {
  0x000000,0x000000,0x000000,0x000000,0x000000,0x000000,0x000000,0x000000,0x000000,0x000000,0x000000,0x000000,0x000000,0x000000,0x000000,0x000000,
  0x000000,0x000000,0x000000,0x000000,0x000000,0x000000,0x000000,0x000000,0x000000,0x000000,0x000000,0x000000,0x000000,0x000000,0x000000,0x000000,
  0x000000,0x000000,0x000000,0x000000,0x000000,0x000000,0x000000,0x000000,0x000000,0x000000,0x000000,0x000000,0x000000,0x000000,0x000000,0x000000,
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  0x000000,0x000000,0x000000,0x000000,0x000000,0x000000,0x000000,0x000000,0x000000,0x000000,0x000000,0x000000,0x000000,0x000000,0x000000,0x000000
};

// ---------------------------------------------------------------------------
// Interne Hilfsfunktionen
// ---------------------------------------------------------------------------

// Wandelt Serpentinen-Koordinate (x,y) in LED-Index um
static inline uint16_t olb_xy(uint8_t x, uint8_t y) {
  if (y % 2 == 0) {
    return y * OLB_INIT_MATRIX_W + (OLB_INIT_MATRIX_W - 1 - x); // gerade: rechts→links
  } else {
    return y * OLB_INIT_MATRIX_W + x;                             // ungerade: links→rechts
  }
}


// Setzt eine komplette Zeile aus einem PROGMEM-Frame mit gegebenem Helligkeitsfaktor (0..255)
// bright: 255 = volle Farbe, 128 = halbe Farbe
static void olb_setRow(CRGB* leds, const uint32_t* frame, uint8_t row, uint8_t bright) {
  for (uint8_t x = 0; x < OLB_INIT_MATRIX_W; x++) {
    uint32_t color = pgm_read_dword(&frame[row * OLB_INIT_MATRIX_W + x]);
    uint8_t r = ((color >> 16) & 0xFF);
    uint8_t g = ((color >>  8) & 0xFF);
    uint8_t b = ((color      ) & 0xFF);
    // Helligkeit skalieren
    r = (uint8_t)((uint16_t)r * bright / 255);
    g = (uint8_t)((uint16_t)g * bright / 255);
    b = (uint8_t)((uint16_t)b * bright / 255);
    leds[olb_xy(x, row)] = CRGB(r, g, b);
  }
}

// Löscht eine komplette Zeile
static void olb_clearRow(CRGB* leds, uint8_t row) {
  for (uint8_t x = 0; x < OLB_INIT_MATRIX_W; x++) {
    leds[olb_xy(x, row)] = CRGB::Black;
  }
}

// Löscht das gesamte Display
static void olb_clearAll(CRGB* leds) {
  for (uint16_t i = 0; i < OLB_INIT_NUM_LEDS; i++) {
    leds[i] = CRGB::Black;
  }
}

// Zeigt einen Frame (ein Wort) mit Scanline-Drop-Animation:
// 1. Zeilenweise einblenden: erst gedimmt, dann voll hell
// 2. Pause
// 3. Zeilenweise ausblenden (von oben nach unten)
static void olb_scanlineWord(CRGB* leds, const uint32_t* frame) {

  // --- Phase 1: Zeilenweise einblenden, erst gedimmt ---
  for (uint8_t row = 0; row < OLB_INIT_MATRIX_H; row++) {
    olb_setRow(leds, frame, row, OLB_INIT_DIM_BRIGHTNESS);
    FastLED.show();
    delay(OLB_INIT_SCANLINE_MS);
  }

  // --- Phase 1b: Alle Zeilen auf volle Helligkeit aufhellen ---
  for (uint8_t row = 0; row < OLB_INIT_MATRIX_H; row++) {
    olb_setRow(leds, frame, row, 255);
  }
  FastLED.show();

  // --- Phase 2: Pause ---
  delay(OLB_INIT_PAUSE_MS);

  // --- Phase 3: Zeilenweise ausblenden ---
  for (uint8_t row = 0; row < OLB_INIT_MATRIX_H; row++) {
    olb_clearRow(leds, row);
    FastLED.show();
    delay(OLB_INIT_FADEOUT_MS);
  }
}

// Zeigt das letzte Wort ("box") mit Scanline-Drop + Flackern am Ende statt Ausblenden
static void olb_scanlineWordFinal(CRGB* leds, const uint32_t* frame) {

  // --- Phase 1: Zeilenweise einblenden, erst gedimmt ---
  for (uint8_t row = 0; row < OLB_INIT_MATRIX_H; row++) {
    olb_setRow(leds, frame, row, OLB_INIT_DIM_BRIGHTNESS);
    FastLED.show();
    delay(OLB_INIT_SCANLINE_MS);
  }

  // --- Phase 1b: Alle Zeilen auf volle Helligkeit ---
  for (uint8_t row = 0; row < OLB_INIT_MATRIX_H; row++) {
    olb_setRow(leds, frame, row, 255);
  }
  FastLED.show();

  // --- Phase 2: Pause ---
  delay(OLB_INIT_PAUSE_MS);

  // --- Phase 3: Flackern (An/Aus) ---
  for (uint8_t i = 0; i < OLB_INIT_FLICKER_COUNT; i++) {
    // Aus
    olb_clearAll(leds);
    FastLED.show();
    delay(OLB_INIT_FLICKER_MS);
    // An
    for (uint8_t row = 0; row < OLB_INIT_MATRIX_H; row++) {
      olb_setRow(leds, frame, row, 255);
    }
    FastLED.show();
    delay(OLB_INIT_FLICKER_MS);
  }

  // --- Phase 4: Finales Ausblenden ---
  delay(OLB_INIT_PAUSE_MS);
  olb_clearAll(leds);
  FastLED.show();
}

// ---------------------------------------------------------------------------
// Öffentliche API
// ---------------------------------------------------------------------------

/**
 * olb_v1_playIntro(leds)
 *
 * Spielt die komplette Startanimation ab.
 * Voraussetzung: FastLED wurde im Hauptprogramm mit
 *   FastLED.addLeds<WS2812B, OLB_INIT_LED_PIN, GRB>(leds, OLB_INIT_NUM_LEDS);
 *   FastLED.setBrightness(OLB_INIT_BRIGHTNESS);
 * initialisiert.
 *
 * Aufruf: olb_v1_playIntro(leds);
 */
static void olb_v1_playIntro(CRGB* leds) {
  olb_clearAll(leds);
  FastLED.show();

  olb_scanlineWord(leds,      OLB_FRAME_OPEN);
  olb_scanlineWord(leds,      OLB_FRAME_LUX);
  olb_scanlineWordFinal(leds, OLB_FRAME_BOX);
}

#endif // OLB_INIT_H

